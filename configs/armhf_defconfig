## configs/armhf_defconfig
```kconfig
BR2_arm=y
BR2_cortex_a53=y
BR2_ARM_EABIHF=y
BR2_TOOLCHAIN_BUILDROOT_GLIBC=y
BR2_KERNEL_HEADERS_VERSION=y
BR2_DEFAULT_KERNEL_VERSION="4.9.170"
BR2_PACKAGE_HOST_LINUX_HEADERS_CUSTOM_4_9=y
BR2_PACKAGE_SDL2=y
BR2_PACKAGE_ALSA_LIB=y
BR2_PACKAGE_ZLIB=y
BR2_PACKAGE_LIBPNG=y
BR2_PACKAGE_FREETYPE=y
BR2_TARGET_ROOTFS_TAR=y
# BR2_TARGET_ROOTFS_EXT2 is not set
```
